## main/Kconfig.projbuild
```kconfig
menu "Example Configuration"

    config EXAMPLE_WIFI_SSID
        string "WiFi SSID"
        default "myssid"
        help
            SSID (network name) for the example to connect to.

    config EXAMPLE_WIFI_PASSWORD
        string "WiFi Password"
        default "mypassword"
        help
            WiFi password (WPA or WPA2) for the example to use.

    config AWS_IOT_THING_NAME
        string "AWS IoT Thing Name"
        default "ESP-AWS-IoT-Demo"
        help
            AWS IoT Thing Name
                
    config AWS_IOT_CLIENT_ID
        string "AWS IoT Client ID"
        default "ESP32-CLIENT"
        help
            AWS IoT Client Name

    choice EXAMPLE_SCAN_METHOD
        prompt "scan method"
        default EXAMPLE_WIFI_FAST_SCAN
        help
            scan method for the esp32 to use

        config EXAMPLE_WIFI_FAST_SCAN
            bool "fast"
        config EXAMPLE_WIFI_ALL_CHANNEL_SCAN
            bool "all"
    endchoice

    choice EXAMPLE_SORT_METHOD
        prompt "sort method"
        default EXAMPLE_WIFI_CONNECT_AP_BY_SIGNAL
        help
            sort method for the esp32 to use

        config EXAMPLE_WIFI_CONNECT_AP_BY_SIGNAL
            bool "rssi"
        config EXAMPLE_WIFI_CONNECT_AP_BY_SECURITY
            bool "authmode"
    endchoice

    config EXAMPLE_FAST_SCAN_THRESHOLD
        bool "fast scan threshold"
        default y
        help
            wifi fast scan threshold

    config EXAMPLE_FAST_SCAN_MINIMUM_SIGNAL
        int "fast scan minimum rssi"
        depends on EXAMPLE_FAST_SCAN_THRESHOLD
        range -127 0
        default -127
        help
            rssi is use to measure the signal

    choice EXAMPLE_FAST_SCAN_WEAKEST_AUTHMODE
        prompt "fast scan weakest authmode"
        depends on EXAMPLE_FAST_SCAN_THRESHOLD
        default EXAMPLE_FAST_SCAN_WEAKEST_AUTHMODE_OPEN

        config EXAMPLE_FAST_SCAN_WEAKEST_AUTHMODE_OPEN
            bool "open"
        config EXAMPLE_FAST_SCAN_WEAKEST_AUTHMODE_WEP
            bool "wep"
        config EXAMPLE_FAST_SCAN_WEAKEST_AUTHMODE_WPA
            bool "wpa"
        config EXAMPLE_FAST_SCAN_WEAKEST_AUTHMODE_WPA2
            bool "wpa2"
    endchoice

    choice EXAMPLE_CERT_SOURCE
        prompt "AWS IoT Certificate Source"
        default EXAMPLE_EMBEDDED_CERTS
        help
            AWS IoT requires loading of a device-specific certificate and private key,
            and a common Root CA Certificate. These can be compiled into the example
            app, or they can be loaded via the filesystem from an SD card.

        config EXAMPLE_EMBEDDED_CERTS
            bool "Embed into app"
        config EXAMPLE_SDCARD_CERTS
            bool "Load from SD card"
            select EXAMPLE_FILESYSTEM_CERTS
    endchoice

endmenu

menu "GSM PPPoS configuration"

    config GSM_DEBUG
        bool "Enable GSM debugging"
        default y
        help
            Show GSM debug messages
    
    config GSM_TX
        int "UART Output to GSM Module"
        default 21
        range 1 30
        help
        UART Tx pin, connected to GSM Module Rx pin.
    
    config GSM_RX
        int "UART Input from GSM Module"
        default 31
        range 1 38
        help
        UART Rx pin, connected to GSM Module Tx pin.
    
    config GSM_DTS
        int "RTS pin"
        default 31
        range 1 38
        help
        DTS pin, for flow control.
    
    config GSM_CTS
        int "CTS pin"
        default 31
        range 1 38
        help
        CTS pin, for flow control.

    config GSM_DTR
        int "DTR pin"
        default 25
        range 1 38
        help
        DTR pin setup for setting sleep mode for sim7000.

    config GSM_PWR
        int "PWR pin"
        default 5
        range 1 38
        help
        Power Pin.
    
    config GSM_BDRATE
        int "UART Baud rate"
        default 115200
        help
        UART baudrate to comunicate with GSM module
    
    config GSM_INTERNET_USER
        string "Internet User"
        default ""
        help
            Network provider internet user.
    
    config GSM_INTERNET_PASSWORD
        string "Internet password"
        default ""
        help
            Network provider internet password
            
    config GSM_APN
        string "Internet APN"
        default "providerAPN"
        help
           Network provider's APN for internet access
    
    config GSM_USE_WIFI_AP
        bool "Start WiFi and AP"
        default n
        help
            Start WiFi as Acces Point and create WebServer task
    
    config GSM_SEND_SMS
        bool "Send SMS message"
        default n
        help
            Send SMS messages during example run
    
    config GSM_SMS_NUMBER
        string "SMS number"
           depends on GSM_SEND_SMS
        default "+1998765432"
        help
           SMS number for sending messages
           Enter the number in international format (+123999876543)
    
    config GSM_SMS_INTERVAL
        int "SMS message interval"
           depends on GSM_SEND_SMS
        default 300000
        range 180000 3600000
        help
        Set SMS message interval in mili seconds
    
    endmenu
```
